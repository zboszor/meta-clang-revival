## conf/layer.conf
```bitbake
# We have a conf directory, append to BBPATH
BBPATH .= ":${LAYERDIR}"

# We have a recipes directory, add to BBFILES
BBFILES += " \
	${LAYERDIR}/recipes-*/*/*.bb \
	${LAYERDIR}/recipes-*/*/*.bbappend \
"

BBFILES_DYNAMIC += " \
	intel:${LAYERDIR}/dynamic-layers/intel/*/*/*.bb \
	intel:${LAYERDIR}/dynamic-layers/intel/*/*/*.bbappend \
"

BBFILE_COLLECTIONS += "clang-revival-layer"
BBFILE_PATTERN_clang-revival-layer := "^${LAYERDIR}/"
BBFILE_PRIORITY_clang-revival-layer = "8"

LAYERVERSION_clang-revival-layer = "1"
LAYERSERIES_COMPAT_clang-revival-layer = "whinlatter"

LAYERDEPENDS_clang-revival-layer = "core"
LAYERRECOMMENDS_clang-revival-layer = "intel"

LLVM20VERSION = "20.1.8"
LLVM17VERSION = "17.0.6"
LLVM16VERSION = "16.0.6"
LLVM15VERSION = "15.0.7"
LLVM14VERSION = "14.0.6"

# vulkan-sdk-1.4.321.0
SPIRV_HEADERS_SRCREV = "2a611a970fdbc41ac2e3e328802aed9985352dca"
SPIRV_TOOLS_SRCREV = "33e02568181e3312f49a3cf33df470bf96ef293a"

# Do not install the llvm-tblgen-native dependency of lld-native.
# It's not needed for lld to run, but conflicts with CLANG/LLVM
# versions other than the upstream one in oe-core.
SSTATE_EXCLUDEDEPS_SYSROOT += "\
    lld-native->llvm-tblgen-native \
"
```
